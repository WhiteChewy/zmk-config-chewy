## boards/shields/cosmorat/Kconfig.defconfig
```kconfig
if SHIELD_CHEWY_LEFT
    config SPI
        default y
    config ZMK_POINTING
        default y
endif

if SHIELD_CHEWY_DONGLE
    config ZMK_SPLIT_ROLE_CENTRAL
        default y
    config ZMK_POINTING
        default y
endif
```

## boards/shields/cosmorat/Kconfig.shield
```kconfig
config SHIELD_CHEWY_LEFT
	def_bool $(shields_list_contains,chewy_left)

config SHIELD_CHEWY_RIGHT
	def_bool $(shields_list_contains,chewy_right)
```
